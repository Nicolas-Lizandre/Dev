library ieee;
use ieee.std_logic_1164.all;
use ieee.numeric_std.all;

library pll;
use pll.all;

entity telecran is
   port (
		-- FPGA
		i_clk_50: in std_logic;

		-- HDMI
		io_hdmi_i2c_scl       : inout std_logic;
		io_hdmi_i2c_sda       : inout std_logic;
		o_hdmi_tx_clk        : out std_logic;
		o_hdmi_tx_d          : out std_logic_vector(23 downto 0);
		o_hdmi_tx_de         : out std_logic;
		o_hdmi_tx_hs         : out std_logic;
		i_hdmi_tx_int        : in std_logic;
		o_hdmi_tx_vs         : out std_logic;

		-- KEYs
		i_rst_n : in std_logic;

		-- LEDs
		o_leds : out std_logic_vector(9 downto 0);
		o_de10_leds : out std_logic_vector(7 downto 0);

		-- Coder
		i_left_ch_a : in std_logic;
		i_left_ch_b : in std_logic;
		i_left_pb : in std_logic; 		---Button_reset_drawing
		i_right_ch_a : in std_logic;
		i_right_ch_b : in std_logic;
		i_right_pb : in std_logic
		
   );
end entity telecran;

architecture rtl of telecran is

	component hdmi_controler is
		generic (
			-- Resolution
			h_res : positive := 720;
			v_res : positive := 480;

			-- Timings magic values (480p)
			h_sync : positive := 61;
			h_fp : positive := 58;
			h_bp : positive := 18;

			v_sync : positive := 5;
			v_fp : positive := 30;
			v_bp : positive := 9
		);
		port(
			i_clk : in std_logic;
			i_rst_n : in std_logic;
			o_hdmi_hs : out std_logic;
			o_hdmi_vs : out std_logic;
			o_hdmi_de : out std_logic;
			o_pixel_en : out std_logic;
			o_pixel_address : out natural range 0 to (h_res * v_res - 1);
			o_x_counter : out natural range 0 to (h_res - 1);
			o_y_counter : out natural range 0 to (v_res - 1)
			
		);
	end component;
	
	component encoder_decoder is
		generic (
			COUNTER_WIDTH : positive := 10;
			INITIAL_VALUE : integer  := 0;
			SAMPLE_PERIOD : positive := 270000
		);
		port (
			i_clk   : in  std_logic;
			i_rst_n : in  std_logic;
			i_ch_a  : in  std_logic;
			i_ch_b  : in  std_logic;
			o_count : out signed(COUNTER_WIDTH - 1 downto 0)
		);
	end component;

	component I2C_HDMI_Config 
		port (
			iCLK : in std_logic;
			iRST_N : in std_logic;
			I2C_SCLK : out std_logic;
			I2C_SDAT : inout std_logic;
			HDMI_TX_INT  : in std_logic
		);
	end component;
	 
	component pll 
		port (
			refclk : in std_logic;
			rst : in std_logic;
			outclk_0 : out std_logic;
			locked : out std_logic
		);
	end component;
	
	component dualpRAM
  port (
		clock		: IN STD_LOGIC  := '1';
		data		: IN STD_LOGIC_VECTOR (0 DOWNTO 0);
		rdaddress		: IN STD_LOGIC_VECTOR (18 DOWNTO 0);
		wraddress		: IN STD_LOGIC_VECTOR (18 DOWNTO 0);
		wren		: IN STD_LOGIC  := '0';
		q		: OUT STD_LOGIC_VECTOR (0 DOWNTO 0)
  );
end component;
	
	
   constant h_res : natural := 720;
   constant v_res : natural := 480;

	signal s_clk_27 : std_logic;
	signal s_rst_n : std_logic;	-- holds reset as long as pll is not locked
	signal s_pll_rst : std_logic;
	
	signal s_x_counter : natural range 0 to h_res - 1;
	signal s_y_counter : natural range 0 to v_res - 1;

	-- Signals for pixel position, controled by encoders
   signal s_pixel_x : natural range 0 to h_res - 1 := h_res / 2;
   signal s_pixel_y : natural range 0 to v_res - 1 := v_res / 2;

	signal s_encoder_x_count : signed(9 downto 0);
   signal s_encoder_y_count : signed(9 downto 0);
	--- Dual_port_ram
	signal s_address_write :  std_logic_vector(18 downto 0);
	signal s_address_read :  std_logic_vector(18 downto 0);
   signal s_data_write    :  std_logic_vector(0 downto 0);
   signal s_wren    :  std_logic;
   signal s_q_read       :  std_logic_vector(0 downto 0);
	
	--- STATE of the system
	type STATE_TYPE is (ERASING,DRAWING);
	signal CURRENT_STATE : STATE_TYPE:=DRAWING;
	signal NEXT_STATE : STATE_TYPE;
	signal erasing_pixel_count : natural;
begin
	-- o_leds <= (others => '0');
	-- o_de10_leds <= (others => '0');
	s_pll_rst <= not i_rst_n;
	
	-- Frequency for HDMI is 27MHz generated by this PLL
	pll0 : component pll 
		port map (
			refclk => i_clk_50,
			rst => s_pll_rst,
			outclk_0 => s_clk_27,
			locked => s_rst_n
		);

	-- Configures the ADV7513 for 480p
	I2C_HDMI_Config0 : component I2C_HDMI_Config 
		port map (
			iCLK => i_clk_50,
			iRST_N => i_rst_n,
			I2C_SCLK => io_hdmi_i2c_scl,
			I2C_SDAT => io_hdmi_i2c_sda,
			HDMI_TX_INT => i_hdmi_tx_int
		);
		
	-- Encoder LEFT for position X
	encoder_x : component encoder_decoder
		generic map (
			COUNTER_WIDTH => 10,
			INITIAL_VALUE => h_res / 2 -- Initialise le compteur au centre
		)
		port map (
			i_clk   => s_clk_27,
			i_rst_n => s_rst_n,
			i_ch_a  => i_left_ch_a,
			i_ch_b  => i_left_ch_b,
			o_count => s_encoder_x_count
		);

	-- Encoder RIGHT for position Y
	encoder_y : component encoder_decoder
		generic map (
			COUNTER_WIDTH => 10, -- 10 bits is enough for 480
			INITIAL_VALUE => v_res / 2 -- Initialize the counter at the middle
		)
		port map (
			i_clk   => s_clk_27,
			i_rst_n => s_rst_n,
			i_ch_a  => i_right_ch_a,
			i_ch_b  => i_right_ch_b,
			o_count => s_encoder_y_count
		);

	hdmi_controler_inst : component hdmi_controler
		generic map (
			h_res => h_res,
			v_res => v_res
		)
		port map (
			i_clk => s_clk_27,
			i_rst_n => s_rst_n,
			o_hdmi_hs => o_hdmi_tx_hs,
			o_hdmi_vs => o_hdmi_tx_vs,
			o_hdmi_de => o_hdmi_tx_de,
			o_pixel_en => open,
			o_pixel_address => open,
			o_x_counter => s_x_counter,
			o_y_counter => s_y_counter
		);
		
	dual_port_ram_inst : component dualpRAM
  port map(
    clock => s_clk_27,
    rdaddress => s_address_read,
    data => s_data_write,
    wraddress => s_address_write,
	 wren => s_wren,
    q => s_q_read
  );
  ------STATE_TYPE management
  process(s_clk_27)
  begin
  if(rising_edge(s_clk_27)) then 
		CURRENT_STATE<=NEXT_STATE;
  end if;
  end process;
  
  process(CURRENT_STATE,i_left_pb,erasing_pixel_count)
  begin
  case CURRENT_STATE is
  
  when DRAWING =>
  if(i_left_pb='1') then NEXT_STATE<=ERASING; end if;
  
  when ERASING =>
  if(erasing_pixel_count=345600) then NEXT_STATE<=DRAWING; end if; --It means that all the pixel have been overwritten at least one time
  
  end case;
  end process;
  --erasing_state
  
  
  
		
	-- This process converts and limits the values of the encoders at the screen's size
	process(s_clk_27, s_rst_n)
	begin
		if s_rst_n = '0' then
			s_pixel_x <= h_res / 2;
			s_pixel_y <= v_res / 2;
		elsif rising_edge(s_clk_27) then
			-- Limit the value of X between 0 and h_res-1
			if s_encoder_x_count < 0 then
				s_pixel_x <= 0;
			elsif s_encoder_x_count >= h_res then
				s_pixel_x <= h_res - 1;
			else
				s_pixel_x <= to_integer(s_encoder_x_count);
			end if;

			-- Limit the value of Y between 0 and v_res-1
			if s_encoder_y_count < 0 then
				s_pixel_y <= 0;
			elsif s_encoder_y_count >= v_res then
				s_pixel_y <= v_res - 1;
			else
				s_pixel_y <= to_integer(s_encoder_y_count);
			end if;
		end if;
	end process;
	
	---WritingProcess
	process(s_clk_27)
	begin
		if(s_wren='1' and CURRENT_STATE=ERASING) then s_wren <='0'; end if;
		if(CURRENT_STATE=ERASING) then
		s_wren<='1';
		s_address_write <= std_logic_vector(to_unsigned( s_x_counter +480*s_y_counter,19));
		s_data_write <= "0";
		erasing_pixel_count<=erasing_pixel_count+1;
		elsif((s_x_counter=s_pixel_x) and (s_y_counter=s_pixel_y) and (CURRENT_STATE=DRAWING)) then
			erasing_pixel_count<=0; --I do the reset of the pixel count there
			s_wren<='1';
			s_address_write <= std_logic_vector(to_unsigned( s_x_counter +480*s_y_counter,19));
			s_data_write <= "1";
		end if;
	end process;
----		o_hdmi_tx_d <= x"FFFFFF" when (s_adress_read(to_integer(s_x_counter)+480*to_integer(s_y_counter)) = '1')
	
	o_hdmi_tx_clk <= s_clk_27;
	s_address_read<= std_logic_vector(to_unsigned(s_x_counter+480*s_y_counter,19));
	o_hdmi_tx_d <= x"00FF00" when (s_q_read = "0") else x"000000";

	
	o_leds <= std_logic_vector(s_encoder_x_count);

end architecture rtl;






